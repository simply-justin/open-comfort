## main/Kconfig.projbuild
```kconfig
menu "OpenComfort Product"

    config OPENCOMFORT_PRODUCT_ID
        string "Product identifier"
        default "oc-ac-controller-v1"
        help
            Immutable product identifier baked into the firmware image.

    choice OPENCOMFORT_MODULE
        prompt "Product module"
        default OPENCOMFORT_MODULE_AC
        help
            Selects the functional module compiled into this firmware image.
            Unused modules are excluded at link time.

        config OPENCOMFORT_MODULE_AC
            bool "Air conditioner bridge"
    endchoice

    choice OPENCOMFORT_BOARD
        prompt "Board revision"
        default OPENCOMFORT_BOARD_REV_A

        config OPENCOMFORT_BOARD_REV_A
            bool "Revision A (ESP32-S3)"
    endchoice

    choice OPENCOMFORT_FIRMWARE_PROFILE
        prompt "Firmware capability profile"
        default OPENCOMFORT_PROFILE_HOME_ASSISTANT

        config OPENCOMFORT_PROFILE_HOME_ASSISTANT
            bool "Home Assistant (MQTT), 4 MB flash"

        config OPENCOMFORT_PROFILE_MATTER
            bool "Matter, 8 or 16 MB flash"

        config OPENCOMFORT_PROFILE_FULL
            bool "Full: Home Assistant and Matter, 8 or 16 MB flash"
    endchoice

    config OPENCOMFORT_ENABLE_MATTER
        bool
        default y if OPENCOMFORT_PROFILE_MATTER || OPENCOMFORT_PROFILE_FULL
        default n

    config OPENCOMFORT_ENABLE_MQTT
        bool
        default y if OPENCOMFORT_PROFILE_HOME_ASSISTANT || OPENCOMFORT_PROFILE_FULL
        default n

    config OPENCOMFORT_MATTER_DEVELOPMENT_CREDENTIALS
        bool "Allow development Matter commissioning credentials"
        depends on OPENCOMFORT_ENABLE_MATTER
        default y
        help
            Development only. Production builds must disable this and inject
            unique DAC/PAI/CD, discriminator, and passcode data into fctry.

    config OPENCOMFORT_RUNTIME_HTTP_PORT
        int "Runtime web portal port"
        default 80
        range 1 65535

    config OPENCOMFORT_MQTT_RECONNECT_MAX_MS
        int "Maximum MQTT reconnect delay (ms)"
        default 60000
        range 1000 300000

    config OPENCOMFORT_PORTAL_AP_PASSWORD
        string "Default SoftAP password for portal"
        default "opencomfort"
        help
            WPA2 SoftAP password used during first-time provisioning.
            Prefer overriding per-device at manufacturing time.

    config OPENCOMFORT_PROFILE_CATALOG_URL
        string "Remote profile catalog URL"
        default ""
        help
            Optional HTTPS URL for remote AC profile catalog retrieval.
            Leave empty to use the bundled SPIFFS catalog only.

    config OPENCOMFORT_FACTORY_RESET_HOLD_MS
        int "Factory reset hold time (ms)"
        default 5000
        range 1000 30000
        help
            How long the board factory-reset GPIO must be held to wipe
            user configuration and re-enter the captive portal.

    config OPENCOMFORT_UPDATE_REPO
        string "GitHub repository with firmware releases (owner/name)"
        default "simply-justin/open-comfort"
        help
            The device checks the latest release of this repository daily and
            offers the asset opencomfort-<variant>.bin for its own variant
            (ha-4mb, matter-8mb, matter-16mb, full-8mb or full-16mb). Leave empty to turn
            online updates off; uploading a file in the portal still works.

    config OPENCOMFORT_POWER_CYCLE_RESET_COUNT
        int "Factory reset after this many quick power cycles (0 = off)"
        default 5
        range 0 10
        help
            For devices without a reachable button: switching the power on this
            many times in a row, each time for less than the window below, wipes
            the configuration. Only power-on resets count; crashes, watchdog and
            brownout resets break the sequence.

    config OPENCOMFORT_POWER_CYCLE_WINDOW_MS
        int "Quick power cycle window (ms)"
        default 10000
        range 3000 60000
        help
            A power-on counts towards a reset only if the device is switched off
            again within this time.

endmenu
```
